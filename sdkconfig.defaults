## sdkconfig.defaults
```kconfig
CONFIG_IDF_TARGET="esp32c5"

# WiFi Configuration for 5GHz ESP-NOW
CONFIG_ESP_WIFI_ENABLE_WPA3_SAE=y
CONFIG_ESP_WIFI_SOFTAP_SUPPORT=y
CONFIG_ESP_WIFI_STA_SUPPORT=y

# ESP-NOW Configuration
CONFIG_ESP_WIFI_ESPNOW_MAX_ENCRYPT_NUM=7

# Logging Configuration for Testing
CONFIG_LOG_DEFAULT_LEVEL_DEBUG=y
CONFIG_LOG_MAXIMUM_LEVEL_DEBUG=y

# Performance Optimization
CONFIG_ESP_DEFAULT_CPU_FREQ_240=y
CONFIG_FREERTOS_HZ=1000

# Memory Configuration
CONFIG_ESP_MAIN_TASK_STACK_SIZE=8192
CONFIG_ESP_TASK_WDT_EN=n
```
